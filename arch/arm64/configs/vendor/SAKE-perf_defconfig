## arch/arm64/configs/vendor/SAKE-perf_defconfig
```kconfig
# ASUS SAKE begin ##################
CONFIG_MACH_ASUS_SAKE=y
CONFIG_TOUCHSCREEN_FTS_ZF=m
# CONFIG_TOUCHSCREEN_ST is not set
# CONFIG_TOUCHSCREEN_FTS is not set
CONFIG_GOODIX_FINGERPRINT_2ND=m
CONFIG_SLA_STAIC_COLLECT=y
CONFIG_SLA=m
CONFIG_NETFILTER_XT_TARGET_LOG=y
CONFIG_NETFILTER_XT_MATCH_MULTIPORT=y
CONFIG_AW8697_HAPTIC=m
CONFIG_I2C_RTC6226_QCA=y
# CONFIG_INPUT_QCOM_HV_HAPTICS is not set
CONFIG_INPUT_SX932X_SAKE=m
CONFIG_ASUS_POWER_DEBUG=y
CONFIG_CGF_NOTIFY_EVENT=y
CONFIG_USB_ANNOUNCE_NEW_DEVICES=y
#add configs to user build
# CONFIG_SPMI_MSM_PMIC_ARB_DEBUG is not set
# CONFIG_MSM_GPI_DMA_DEBUG is not set
# CONFIG_MSM_DEBUGCC_LAHAINA is not set
# CONFIG_SM_DEBUGCC_SHIMA is not set
# CONFIG_IOMMU_TLBSYNC_DEBUG is not set
# CONFIG_QTI_BATTERY_GLINK_DEBUG is not set
# CONFIG_SERIAL_MSM_GENI_CONSOLE is not set
# CONFIG_STM is not set
# CONFIG_DEBUG_STACK_USAGE is not set
# CONFIG_DEBUG_MEMORY_INIT is not set
CONFIG_QCOM_RTB=y
CONFIG_QCOM_RTB_QGKI=y
CONFIG_QCOM_RTB_SEPARATE_CPUS=y
CONFIG_QCOM_WDT_CORE=y
# CONFIG_KPROBES is not set
CONFIG_CORESIGHT=y
CONFIG_CORESIGHT_LINKS_AND_SINKS=y
CONFIG_CORESIGHT_LINK_AND_SINK_TMC=y
CONFIG_CORESIGHT_SOURCE_ETM4X=y
CONFIG_CORESIGHT_DYNAMIC_REPLICATOR=y
CONFIG_CORESIGHT_STM=y
CONFIG_CORESIGHT_CTI=y
CONFIG_CORESIGHT_OST=y
CONFIG_CORESIGHT_TPDA=y
CONFIG_CORESIGHT_TPDM=y
CONFIG_CORESIGHT_HWEVENT=y
CONFIG_CORESIGHT_DUMMY=y
CONFIG_CORESIGHT_REMOTE_ETM=y
CONFIG_CORESIGHT_REMOTE_ETM_DEFAULT_ENABLE=0
CONFIG_CORESIGHT_CSR=y
CONFIG_CORESIGHT_TGU=y
CONFIG_CORESIGHT_EVENT=y
CONFIG_CORESIGHT_QGKI=y
CONFIG_CORESIGHT_CTI_SAVE_DISABLE=y
CONFIG_QCOM_QDSS_BRIDGE=y
CONFIG_USB_F_QDSS=y
CONFIG_USB_CONFIGFS_F_QDSS=y
CONFIG_DEBUG_ALIGN_RODATA=y
CONFIG_MSM_REMOTEQDSS=y
# CONFIG_QCOM_EUD is not set
#disable below config to improve perf
# CONFIG_SLUB_DEBUG is not set
# CONFIG_SPMI_QTI_GLINK_DEBUG is not set
# CONFIG_DYNAMIC_DEBUG_CORE is not set
# CONFIG_DEBUG_MISC is not set
# CONFIG_DEBUG_BUGVERBOSE is not set
# CONFIG_DEBUG_LIST is not set
# CONFIG_IPC_LOGGING is not set
# CONFIG_SERIAL_EARLYCON is not set
# CONFIG_SERIAL_8250_CONSOLE is not set
# CONFIG_SERIAL_SAMSUNG_CONSOLE is not set
# CONFIG_SERIAL_CORE_CONSOLE is not set
#disable below config to improve memory
# CONFIG_MEMORY_HOTPLUG is not set
# CONFIG_MEMORY_HOTPLUG_DEFAULT_ONLINE is not set
# CONFIG_MEMORY_HOTPLUG_MOVABLE_NODE is not set
# CONFIG_OVERRIDE_MEMORY_LIMIT is not set
# CONFIG_HOTPLUG_SIZE_BITS is not set
# CONFIG_MEMORY_HOTREMOVE is not set
# CONFIG_QCOM_MEM_OFFLINE is not set
CONFIG_SONY_FF=y
CONFIG_HID_PLAYSTATION=y
CONFIG_PLAYSTATION_FF=y
# ASUS SAKE end ####################

# Addon
CONFIG_LOCALVERSION="-Omni-qgki-perf"
CONFIG_BUILD_ARM64_DT_OVERLAY=y

# Wlan
CONFIG_QCA_CLD_WLAN=m
CONFIG_CNSS_QCA6490=y
```
